## ai_who/managed_components/100312dog__opencv-mobile/Kconfig
```kconfig
menu "OpenCV Configuration"
    choice OPENCV_BUILD_MODE
        prompt "Build Mode"
        default OPENCV_PREBUILT
        help
            Select whether to use prebuilt libraries or build from source.

    config OPENCV_PREBUILT
        bool "Use prebuilt libraries"
        help
            Link against prebuilt OpenCV libraries.

    config OPENCV_BUILD_FROM_SOURCE
        bool "Build from source"
        help
            Build OpenCV from source code.
    endchoice

    config OPENCV_PREBUILT_PICOLIBC
    int
        default 1 if OPENCV_PREBUILT && LIBC_PICOLIBC
        default 0

    config OPENCV_PREBUILT_NEWLIB
        int
        default 1 if OPENCV_PREBUILT && (LIBC_NEWLIB || !LIBC_PICOLIBC)
        default 0
endmenu
```

## ai_who/sdkconfig.defaults
```kconfig
CONFIG_IDF_TARGET="esp32s3"

# ===== Flash 配置 =====
# Flash 容量 16MB
CONFIG_ESPTOOLPY_FLASHSIZE_16MB=y
CONFIG_ESPTOOLPY_FLASHSIZE="16MB"
# Flash SPI 模式 QIO
CONFIG_ESPTOOLPY_FLASHMODE_QIO=y
# Flash 时钟 80MHz（16MB QIO 一般配套）
CONFIG_ESPTOOLPY_FLASHFREQ_80M=y

# ===== 分区表配置 =====
# 使用自定义分区表
CONFIG_PARTITION_TABLE_CUSTOM=y
CONFIG_PARTITION_TABLE_CUSTOM_FILENAME="partitions-16Mib.csv"
CONFIG_PARTITION_TABLE_OFFSET=0x9000

# ===== FreeRTOS 配置（WHO 依赖） =====
CONFIG_FREERTOS_HZ=1000
CONFIG_FREERTOS_VTASKLIST_INCLUDE_COREID=y
CONFIG_FREERTOS_GENERATE_RUN_TIME_STATS=y
CONFIG_FREERTOS_RUN_TIME_COUNTER_TYPE_U64=y

# ===== PSRAM 配置（WHO 模型需要） =====
CONFIG_SPIRAM=y
CONFIG_SPIRAM_MODE_OCT=y
CONFIG_SPIRAM_SPEED_80M=y
CONFIG_SPIRAM_XIP_FROM_PSRAM=y
CONFIG_ESP_DEFAULT_CPU_FREQ_MHZ_240=y

# ===== Cache 配置 =====
CONFIG_ESP32S3_INSTRUCTION_CACHE_32KB=y
CONFIG_ESP32S3_DATA_CACHE_64KB=y
CONFIG_ESP32S3_DATA_CACHE_LINE_64B=y
CONFIG_ESP_SYSTEM_ALLOW_RTC_FAST_MEM_AS_HEAP=n

# ===== FATFS / 系统 =====
CONFIG_FATFS_LFN_HEAP=y
CONFIG_COMPILER_OPTIMIZATION_PERF=y
```
